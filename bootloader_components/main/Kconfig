## bootloader_components/main/Kconfig
```kconfig
menu "Bootloader Welcome Message"
    config EXAMPLE_BOOTLOADER_WELCOME_MESSAGE
        string "Custom Bootloader Greeting"
        default "🚀 Welcome to the Ultimate ESP32 Bootloader! 🚀"
        help
            This message is displayed by the custom bootloader during startup.
            Make it fun, informative, or branded to give users a sense of style
            and professionalism when the device powers on.

endmenu
```
